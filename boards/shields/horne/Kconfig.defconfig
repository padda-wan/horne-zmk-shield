## boards/shields/horne/Kconfig.defconfig
```kconfig
if SHIELD_HORNE_LEFT

config ZMK_KEYBOARD_NAME
    default "Horne"

config ZMK_SPLIT_ROLE_CENTRAL
    default y

endif

if SHIELD_HORNE_LEFT || SHIELD_HORNE_RIGHT

config ZMK_SPLIT
    default y

endif
```

## boards/shields/horne/Kconfig.shield
```kconfig
config SHIELD_HORNE_LEFT
    def_bool $(shields_list_contains, horne_left)

config SHIELD_HORNE_RIGHT
    def_bool $(shields_list_contains, horne_right)
```
